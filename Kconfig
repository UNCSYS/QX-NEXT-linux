## Kconfig
```kconfig
menu "QXNEXT"

config QXNEXT
	  tristate "KernelSU function support"
	  default y
	  help
	    Enable kernel-level rootkit privileges on Android System.
	    To compile as a module, choose M here: the
	    module will be called QXNEXT.
endmenu
```
